## main/Kconfig.projbuild
```kconfig
menu "Local audio/video prototype"
config AV_RAW_PROTOTYPE
    bool "Boot standalone raw FAV1 LAN test instead of LVGL demo"
    default n
    help
        Exclusive landscape JPEG/PCM test; does not start LVGL or BLE.
        Supply ignored main/av_private_config.h. No flashing is performed.

config AV_SCREEN_CAPTURE
    bool "Take one screen capture per session and print it to the console"
    depends on AV_RAW_PROTOTYPE
    default n
    help
        Prints a 80x60 subsample of the panel's own input as hex between two
        markers, which tools/screen_capture.py turns into a PNG.

        This is the only way to see what the panel is actually given. Every
        check that compares the server's output against itself, or against a
        second rendering of the same frames, is blind to a fault on the
        device's side of the wire -- and the screen cannot be read from a
        distance. It cost three wrong hypotheses about the colour before this
        existed.

        Off by default: it holds 9600 bytes of heap for one session and prints
        sixty lines of hex, neither of which belongs in an ordinary build.
config AV_USB_TRANSPORT
    bool "Also carry the media stream over the USB cable (measurement builds only)"
    depends on AV_RAW_PROTOTYPE
    default n
    help
        Adds a second transport: the same FAV1 packets down the USB cable
        instead of over the network. Off by default, and the default is the
        product: this device is a network set-top box, and a build that
        prefers a cable whenever one is plugged in is a different product,
        not a faster version of this one.

        On, it exists so the two transports can be measured against each
        other on the same hardware -- which is the only way to say what the
        network path is actually giving up. The reference implementation
        reaches 20 frames a second over this same USB peripheral, and the
        number this build produces answers whether that gap is the transport
        or something about this firmware.

        It costs about 20 KB of internal RAM for the driver's ring buffers,
        held for the life of the device, which is another reason it is not on.

config AV_DISPLAY_BENCH
    bool "Measure the display path in isolation, with the link frozen out"
    depends on AV_RAW_PROTOTYPE
    default n
    help
        Two things a normal build has no way to ask.

        First, a bare panel benchmark: fill a stripe buffer with a constant
        and submit it 15 times a frame for 60 frames, timing the whole run and
        each part of it. It never decodes anything and never reads a socket.
        This is the only measurement of the 4-wire SPI bus at its rated
        40 MHz and therefore the only check on the 30.7 ms floor every other
        figure in this project is compared against -- a floor that has so far
        been arithmetic rather than an observation.

        Second, a stop-the-world freeze. On a serial command the receive task
        stops reading its socket while the picture task carries on consuming
        whatever packets are already queued, and logs the rate it drains them
        at. That rate is the device drawing with no network in the way at all:
        no packet arrival times, no TCP window, no sender pacing. Every
        previous attempt to measure the device's own drawing speed was taken
        during a live session and was therefore measuring the link's supply
        rate instead, which is how "the device is already at the hardware
        floor" got written down twice on evidence that could not show it.

        Off by default. Both measurements need the device quiet and a human
        reading a console, which is not what a set-top box is doing.

config AV_HW_BENCH
    bool "Run the hardware benchmark at boot, before the network starts"
    depends on AV_RAW_PROTOTYPE
    default n
    help
        The successor to AV_DISPLAY_BENCH, and the instrument the handoff of
        2026-09-28 asks for. Every CPU figure in that handoff is arithmetic:
        the cost of receiving a byte, of inflating one, of expanding a pixel.
        None was measured, and the whole optimisation plan is gated on which
        of the three actually binds.

        Three groups, all before any socket exists so nothing here can be
        paced by a sender:

        - The panel, as a bus. Stripe height is swept to separate the fixed
          per-stripe command and synchronisation cost from the pixel clock,
          and one variant sets the window once and pushes the whole frame
          without re-sending it. Two more sweep COLMOD and the SPI clock,
          both of which leave the chip's rated envelope and are therefore
          only meaningful with a human looking at the screen.

        - The CPU, in cycles, on synthesised stripes of known entropy:
          memcpy, ROM tinfl at four compression ratios, the current expander,
          an optimised expander, and a 4x4 block decoder prototype.

        - The receive path, which is the least certain figure of the three
          and the one that sets the CPU ceiling.

        Everything prints as `BENCH name=... key=value` on one line per item,
        which tools/bench_summary.py reads.

        Off by default, and it runs before the network comes up: a device that
        benchmarks on every boot is not a television. AV_DISPLAY_BENCH may be
        on at the same time; the two do not share state.

config AV_HW_BENCH_SPI80
    bool "Also clock the panel SPI at 80 MHz (EXCEEDS THE PANEL'S RATING)"
    depends on AV_HW_BENCH
    default n
    help
        Raises the panel bus from 40 MHz to 80 MHz for the whole build, and
        ONLY for a build that already has AV_HW_BENCH on -- the product is not
        reachable from here, which is the point.

        This exceeds what the panel is specified for. The ST7789 datasheet gives
        a minimum write cycle of 16 ns, which is 62.5 MHz; the C3 can divide its
        80 MHz APB down to 80, 40 or 26.7 MHz and nothing between, so 40 MHz is
        the highest compliant rate and 80 is the next step out of the envelope.
        There is a second, separate reason to doubt it: this board drives SCLK
        and MOSI through the GPIO matrix (GPIO 8 and 9) rather than the SPI2
        IOMUX pins (6 and 7), and Espressif only guarantees those two routes are
        equivalent at or below 40 MHz.

        What the option is for is finding out what happens, because the panel is
        the measured binding constraint -- 23 ms a frame against a 23.04 ms
        floor, where the floor is exactly this clock. Halving the clock period
        would halve the frame time, which is worth more than any other change
        available. If it works, the picture is intact and the frame rate roughly
        doubles; if it does not, the picture tears, shifts, or goes blank, and
        the answer is that the bus cannot go faster and the ceiling is real.

        Whether it works is a question for a person looking at the screen. The
        console can report a frame rate whether or not the pixels arrive, so a
        run of this option is only meaningful with someone watching.
endmenu
```

## sdkconfig.defaults
```kconfig
# --- 目标芯片 ---
CONFIG_IDF_TARGET="esp32c3"
# 注:ESP32-C3 无 PSRAM,故不设 CONFIG_SPIRAM。

# --- Flash ---
# FoloToy AI Passport 当前产品/固件基线使用 8MB Flash。
CONFIG_ESPTOOLPY_FLASHSIZE_8MB=y
# 固定 8MB 镜像头，关闭 detect，便于 idf.py merge-bin。
CONFIG_ESPTOOLPY_HEADER_FLASHSIZE_UPDATE=n
# 3 MB 应用上限与固定保护分区保持一致。分区表保留
# cardid@0x356000，二创不得移动或覆盖。
CONFIG_PARTITION_TABLE_CUSTOM=y
CONFIG_PARTITION_TABLE_CUSTOM_FILENAME="partitions.csv"
CONFIG_PARTITION_TABLE_FILENAME="partitions.csv"

# --- 控制台:USB-Serial-JTAG(C3 原生 USB,GPIO18/19)---
# 不用 UART0:其默认 TX=GPIO21 与本板背光引脚冲突。
CONFIG_ESP_CONSOLE_USB_SERIAL_JTAG=y
CONFIG_ESP_CONSOLE_SECONDARY_NONE=y

# --- LVGL ---
CONFIG_LV_COLOR_DEPTH_16=y
CONFIG_LV_FONT_MONTSERRAT_14=y
CONFIG_LV_FONT_MONTSERRAT_20=y
# LVGL 内置 malloc 池大小(KB)。它是独立静态区、不与系统堆共享,配大了会白白占用 RAM。
# 本 demo UI 简单,24KB 足够;若自建复杂界面出现绘制卡死/看门狗,调大此值。
CONFIG_LV_MEM_SIZE_KILOBYTES=24

# --- 系统 ---
CONFIG_FREERTOS_HZ=1000

# --- TCP 接收窗口 ---
# 默认 5760 字节，而一个视频包最大 16 KB：窗口装不下一个包，链路因此被限在
# 每往返一次只能推进一个窗口，实测设备侧视频入流只有 26–31 KB/s，而 12 fps 的
# 索引画面需要约 420 KB/s。表现是音频欠载、每 8 秒左右断一次会话，看起来像
# Wi-Fi 信号差，实际是窗口太小。
#
# 先调到 32 KB，后来调到 64 KB。窗口大小影响的是流畅度而不是速度：热点上交替
# 测 100 秒，32 KB 是 3 次和 9 次音频中断、各 1 次会话重置，64 KB 是两次都 0 次
# 音频中断、0 次重置，帧率中位数相同（单次运行，见 tcp-delta-progress-20260930）。
# 接收邮箱和 Wi-Fi 动态接收池要跟着放大，否则窗口宣告的比设备装得下的多，多出
# 的部分在驱动里被丢掉（sdkconfig.av-prototype 里有这条的实测）。动态缓冲只在用到
# 时才占堆。发送缓冲保持 32 KB：设备发出的只是控制包。
CONFIG_LWIP_TCP_WND_DEFAULT=65535
CONFIG_LWIP_TCP_SND_BUF_DEFAULT=32768
CONFIG_LWIP_TCP_RECVMBOX_SIZE=48

# --- Bluetooth LE / NimBLE ---
# ESP32-C3 仅支持 BLE；示例只启用单连接 peripheral 所需的最小 host 配置。
CONFIG_BT_ENABLED=y
CONFIG_BT_NIMBLE_ENABLED=y
CONFIG_BT_NIMBLE_ROLE_CENTRAL=n
CONFIG_BT_NIMBLE_ROLE_PERIPHERAL=y
CONFIG_BT_NIMBLE_ROLE_BROADCASTER=y
CONFIG_BT_NIMBLE_ROLE_OBSERVER=n
CONFIG_BT_NIMBLE_MAX_CONNECTIONS=1
CONFIG_BT_NIMBLE_HOST_BASED_PRIVACY=n
CONFIG_BT_NIMBLE_NVS_PERSIST=n
```
